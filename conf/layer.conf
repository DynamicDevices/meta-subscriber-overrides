## conf/layer.conf
```bitbake
# We might have a conf and classes directory, append to BBPATH
BBPATH .= ":${LAYERDIR}"

# We have a recipes directory, add to BBFILES
BBFILES += "${LAYERDIR}/recipes*/*/*.bb ${LAYERDIR}/recipes*/*/*.bbappend"

BBFILE_COLLECTIONS += "meta-subscriber-overrides"
BBFILE_PATTERN_meta-subscriber-overrides := "^${LAYERDIR}/"
BBFILE_PRIORITY_meta-subscriber-overrides = "10"

LAYERSERIES_COMPAT_meta-subscriber-overrides = "nanbield"

MACHINE_FEATURES:remove = " nxp8987-sdio"
MACHINE_FEATURES:append = " nxpiw612-sdio tas2563"
```
